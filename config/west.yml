## config/west.yml
```yaml
manifest:
    remotes:
        - name: zmkfirmware
          url-base: https://github.com/zmkfirmware
        - name: 9u0vad15
          url-base: https://github.com/9u0vad15
    projects:
        - name: zmk
          remote: zmkfirmware
          revision: main
          import: app/west.yml
        # modules
        - name: zmk-dongle-display
          remote: 9u0vad15
          revision: main
    self:
        path: config
```
